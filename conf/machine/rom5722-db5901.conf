## conf/machine/rom5722-db5901.conf
```bitbake
MACHINEOVERRIDES =. "rom5722:"
require conf/machine/imx8mpevk.conf

KERNEL_DEVICETREE_BASENAME = "rom5722-db5901"

KERNEL_DEVICETREE:rom5722 = "freescale/${KERNEL_DEVICETREE_BASENAME}.dtb"

UBOOT_DTB_NAME = "imx8mp-evk.dtb"
```

## conf/machine/rsb3720-4g.conf
```bitbake
MACHINEOVERRIDES =. "rsb3720-4g:"
require conf/machine/imx8mpevk.conf

KERNEL_DEVICETREE_BASENAME = "rsb3720"

KERNEL_DEVICETREE:rsb3720 = "freescale/${KERNEL_DEVICETREE_BASENAME}.dtb"

SERIAL_CONSOLES = "115200;ttymxc2"

ATF_BOOT_UART_BASE = "0x30880000"

UBOOT_DTB_NAME = "imx8mp-evk.dtb"
```

## conf/machine/rsb3720.conf
```bitbake
require conf/machine/imx8mpevk.conf

KERNEL_DEVICETREE_BASENAME = "rsb3720"

SERIAL_CONSOLES="115200;ttymxc2"

ATF_BOOT_UART_BASE = "0x30880000"
```
